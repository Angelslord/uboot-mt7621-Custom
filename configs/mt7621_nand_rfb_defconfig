## configs/mt7621_nand_rfb_defconfig
```kconfig
CONFIG_MIPS=y
CONFIG_SPL_LDSCRIPT="arch/$(ARCH)/mach-mt7621/spl/u-boot-nand-spl.lds"
CONFIG_SPL_GPIO_SUPPORT=y
CONFIG_SPL_SERIAL_SUPPORT=y
CONFIG_ENV_SIZE=0x20000
CONFIG_ENV_OFFSET=0x80000
CONFIG_SPL_SYS_MALLOC_F_LEN=0x100000
CONFIG_DEBUG_UART_BOARD_INIT=y
CONFIG_DEBUG_UART_BASE=0xbe000c00
CONFIG_DEBUG_UART_CLOCK=50000000
CONFIG_MACH_MT7621=y
CONFIG_BOARD_MT7621_NAND_RFB=y
CONFIG_MT7621_LEGACY_DRAMC_BIN=y
CONFIG_MIPS_BOOT_FDT=y
CONFIG_DEBUG_UART=y
CONFIG_LOCALVERSION="v1.0"
CONFIG_NR_DRAM_BANKS=1
# CONFIG_EXPERT is not set
CONFIG_FIT=y
CONFIG_FIT_BEST_MATCH=y
# CONFIG_ARCH_FIXUP_FDT_MEMORY is not set
CONFIG_NAND_BOOT=y
CONFIG_BOOTDELAY=0
CONFIG_USE_BOOTCOMMAND=y
CONFIG_BOOTCOMMAND="mtkautoboot"
CONFIG_DISPLAY_CPUINFO=y
CONFIG_DISPLAY_BOARDINFO_LATE=y
CONFIG_SPL_NAND_SUPPORT=y
CONFIG_SPL_PAYLOAD="u-boot-lzma.img"
CONFIG_SPL_YMODEM_SUPPORT=y
CONFIG_SYS_PROMPT="tah@kt:#"
CONFIG_AUTOBOOT_KEYED=y
CONFIG_AUTOBOOT_STOP_STR="q"
CONFIG_CMD_CONFIG=y
CONFIG_CMD_BOOTMENU=y
# CONFIG_CMD_ELF is not set
# CONFIG_CMD_XIMG is not set
CONFIG_CMD_ENV_CALLBACK=y
CONFIG_CMD_ENV_FLAGS=y
# CONFIG_CMD_FLASH is not set
CONFIG_CMD_GPIO=y
CONFIG_CMD_PART=y
CONFIG_CMD_PCI=y
CONFIG_CMD_USB=y
CONFIG_CMD_TFTPPUT=y
CONFIG_CMD_TFTPSRV=y
# CONFIG_CMD_NFS is not set
CONFIG_CMD_ETHSW=y
CONFIG_CMD_BSP=y
CONFIG_CMD_DISPLAY=y
CONFIG_CMD_MTDPARTS=y
CONFIG_MTDIDS_DEFAULT="nand0=nand0"
CONFIG_MTDPARTS_DEFAULT="mtdparts=nand0:512k(u-boot),512k(u-boot-env),256k(factory),-(firmware)"
CONFIG_OF_CONTROL=y
CONFIG_OF_BOARD_FIXUP=y
CONFIG_SPL_OF_CONTROL=y
CONFIG_OF_LIVE=y
CONFIG_OF_EMBED=y
CONFIG_DEFAULT_DEVICE_TREE="mt7621_nand_rfb"
CONFIG_SPL_OF_PLATDATA=y
CONFIG_ENV_IS_IN_NAND=y
CONFIG_ENV_SECT_SIZE=0x20000
CONFIG_NET_RANDOM_ETHADDR=y
# CONFIG_DM_WARN is not set
# CONFIG_DM_DEVICE_REMOVE is not set
# CONFIG_DM_STDIO is not set
# CONFIG_DM_SEQ_ALIAS is not set
CONFIG_REGMAP=y
CONFIG_SYSCON=y
# CONFIG_SIMPLE_BUS is not set
# CONFIG_OF_TRANSLATE is not set
CONFIG_DMA=y
CONFIG_DM_GPIO=y
CONFIG_MT7621_GPIO=y
CONFIG_LED=y
CONFIG_LED_BLINK=y
CONFIG_LED_GPIO=y
CONFIG_LED_STATUS=y
CONFIG_LED_STATUS_GPIO=y
CONFIG_LED_STATUS0=y
CONFIG_LED_STATUS_BIT=20
CONFIG_LED_STATUS1=y
CONFIG_LED_STATUS_BIT1=21
CONFIG_LED_STATUS2=y
CONFIG_LED_STATUS_BIT2=22
CONFIG_LED_STATUS3=y
CONFIG_LED_STATUS_BIT3=23
CONFIG_LED_STATUS4=y
CONFIG_LED_STATUS_BIT4=14
CONFIG_LED_STATUS5=y
CONFIG_LED_STATUS_BIT5=25
CONFIG_LED_STATUS_BOOT_ENABLE=y
CONFIG_LED_STATUS_BOOT=13
CONFIG_MISC=y
CONFIG_WINBOND_W83627=y
CONFIG_MTD=y
CONFIG_MTD_PARTITIONS=y
CONFIG_NMBM=y
CONFIG_NMBM_MTD=y
CONFIG_NAND_MT7621=y
CONFIG_SPL_NAND_MT7621=y
CONFIG_PHY_DAVICOM=y
CONFIG_DM_ETH=y
CONFIG_PHY_GIGE=y
CONFIG_MT7621_ETH=y
CONFIG_PINCTRL=y
CONFIG_PINCONF=y
CONFIG_PINCTRL_MT7621=y
CONFIG_DM_SERIAL=y
CONFIG_DEBUG_UART_MTK=y
CONFIG_DEBUG_UART_SHIFT=2
CONFIG_MTK_SERIAL=y
CONFIG_LZMA=y
CONFIG_SPL_LZMA=y
# CONFIG_SPL_OF_LIBFDT is not set
CONFIG_WEBUI_FAILSAFE=y
CONFIG_WEBUI_FAILSAFE_ON_AUTOBOOT_FAIL=y
CONFIG_FAILSAFE_ON_BUTTON=y
```

## failsafe/Kconfig
```kconfig
#
# Failsafe Web UI
#

menuconfig WEBUI_FAILSAFE
	bool "Enable Failsafe Web UI"
	select TCP
	select HTTPD
	default y
	help
	  Enable Web based failsafe UI

if WEBUI_FAILSAFE

config WEBUI_FAILSAFE_ON_AUTOBOOT_FAIL
	bool "Start Failsafe Web UI on autoboot failure"
	default y

config FAILSAFE_ON_BUTTON
	bool "Press and hold the reset button to enter the failsafe mode"
	default y

endif # WEBUI_FAILSAFE
```
